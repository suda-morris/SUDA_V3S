## kernel/linux-zero-4.10.y/Documentation/devicetree/bindings/input/touchscreen/ns2009.txt
```
* Nsiway NS2009 Resistive Touchscreen Controller

Required properties:
- compatible		  : "nsiway,ns2009"
- reg			  : I2C slave address of the chip (0x48 or 0x49, depends on
			    the hardware)

Optional properties:
- interrupt-parent	  : a phandle pointing to the interrupt controller
			    serving the interrupt for this chip
- interrupts		  : interrupt specification for the ns2009 pen interrupt
- properties defined in touchscreen.txt

Example:

i2c@00000000 {
	ns2009: touchscreen@48 {
		compatible = "nsiway,ns2009";
		reg = <0x48>;
		touchscreen-fuzz-x = <8>;
		touchscreen-fuzz-y = <8>;
	};
};
```

## rootfs/buildroot-2017.11.1/licheepi_zero_defconfig
```kconfig
BR2_arm=y
BR2_cortex_a7=y
BR2_TOOLCHAIN_EXTERNAL=y
BR2_TOOLCHAIN_EXTERNAL_CUSTOM=y
BR2_TOOLCHAIN_EXTERNAL_PATH="/home/morris/SUDA_V3S/toolchains/gcc-linaro-6.4.1-2017.11-x86_64_arm-linux-gnueabihf"
BR2_TOOLCHAIN_EXTERNAL_CUSTOM_PREFIX="$(ARCH)-linux-gnueabihf"
BR2_TOOLCHAIN_EXTERNAL_GCC_6=y
BR2_TOOLCHAIN_EXTERNAL_HEADERS_4_6=y
BR2_TOOLCHAIN_EXTERNAL_CUSTOM_GLIBC=y
BR2_TOOLCHAIN_EXTERNAL_CXX=y
BR2_TARGET_GENERIC_HOSTNAME="suda-v3s"
BR2_TARGET_GENERIC_ISSUE="Welcome to SUDA-V3S"
BR2_ROOTFS_DEVICE_CREATION_DYNAMIC_MDEV=y
BR2_ROOTFS_DEVICE_TABLE_SUPPORTS_EXTENDED_ATTRIBUTES=y
BR2_TARGET_GENERIC_ROOT_PASSWD="321woaini"
BR2_SYSTEM_BIN_SH_BASH=y
BR2_TARGET_GENERIC_GETTY_PORT="ttyS0"
BR2_TARGET_GENERIC_GETTY_BAUDRATE_115200=y
BR2_SYSTEM_DHCP="eth0"
BR2_PACKAGE_BUSYBOX_SHOW_OTHERS=y
BR2_PACKAGE_PYTHON3=y
BR2_PACKAGE_PYTHON3_CURSES=y
BR2_PACKAGE_PYTHON3_READLINE=y
BR2_PACKAGE_PYTHON3_SSL=y
BR2_PACKAGE_PYTHON3_SQLITE=y
BR2_PACKAGE_PYTHON3_PYEXPAT=y
BR2_PACKAGE_OPENSSH=y
BR2_PACKAGE_VIM=y
```
